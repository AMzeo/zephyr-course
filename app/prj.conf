## CMakeLists.txt
```
cmake_minimum_required(VERSION 3.20.0)

list(APPEND BOARD_ROOT ${CMAKE_CURRENT_SOURCE_DIR}/..)

find_package(Zephyr REQUIRED)
project(my_zephyr_app)

target_sources(app PRIVATE src/main.cpp)
add_subdirectory(drivers/our_driver)
```

## Kconfig
```
menuconfig LED_SUBSYSTEM
    bool "LED Subsystem"
    default y
    help
      Enable the LED subsystem.

if LED_SUBSYSTEM

choice LED_SLEEP_TIME
    prompt "Sleep time (ms)"
    default LED_SLEEP_1000

config LED_SLEEP_1000
    bool "1000"

config LED_SLEEP_5000
    bool "5000"

endchoice

menuconfig LED_ADVANCED
    bool "Advanced LED settings"
    default n
    help
      Enable advanced LED configuration options.

if LED_ADVANCED

config LED_BRIGHTNESS
    int "Brightness (%)"
    range 0 100
    default 100

config LED_FADE_DURATION
    int "Fade duration (ms)"
    range 0 10000
    default 500

menuconfig LED_EXPERT
    bool "Expert settings"
    default n
    help
      Enable expert LED configuration options.

if LED_EXPERT

config LED_EXPERT_DIAGNOSTICS
    bool "Enable diagnostics"
    default n

config LED_EXPERT_FORCE
    bool "Force LED update"
    default n

endif # LED_EXPERT

endif # LED_ADVANCED

endif # LED_SUBSYSTEM

config APP_HEARTBEAT_PERIOD_MS
    int "Heartbeat LED period (ms)"
    range 100 2000
    default 500
    help
      Time in milliseconds between heartbeat LED toggles.

source "Kconfig.zephyr"
rsource "drivers/our_driver/Kconfig"
```

## prj.conf
```kconfig
CONFIG_GPIO=y
CONFIG_LOG=y

# Enable UART
CONFIG_SERIAL=y

# Console
CONFIG_CONSOLE=y
CONFIG_UART_CONSOLE=y

CONFIG_LOG_BACKEND_UART=y
CONFIG_PRINTK=y

CONFIG_OUR_DRIVER=y
```

## app.overlay
```dts
/ {
    aliases {
        app-led = &green_led;
        app-led1 = &blue_led;
        app-led2 = &red_led;
    };
};

/ {
    our_driver0: our_driver {
        compatible = "our,driver";
        status = "okay";
    };
};

/ {
    our_custom0: our_custom {
    compatible = "our,custom";
    status = "okay";
    };
};
```

## src/main.cpp
```c
#include <zephyr/drivers/gpio.h>
#include <zephyr/kernel.h>
#include <zephyr/logging/log.h>
#include <zephyr/drivers/sensor.h>
#include "../drivers/our_driver/our_driver.h"

#define SLEEP_TIME_MS CONFIG_APP_HEARTBEAT_PERIOD_MS

/* The devicetree node identifier for the "led0" alias. */
#define LED_NODE DT_ALIAS(app_led2)

static const struct gpio_dt_spec led = GPIO_DT_SPEC_GET(LED_NODE, gpios);

LOG_MODULE_REGISTER(main, LOG_LEVEL_INF);

namespace {
    void test() 
{
        const struct device *driver =
        DEVICE_DT_GET(DT_NODELABEL(our_driver0));

    if (!device_is_ready(driver)) {
        LOG_ERR("Driver is not ready");
        return;
    }

    struct sensor_value val{};

    int ret = sensor_sample_fetch(driver);
    LOG_INF("Fetch ret: %d", ret);

    k_msleep(2000);

    ret = sensor_channel_get(
        driver, SENSOR_CHAN_AMBIENT_TEMP, &val);
    LOG_INF("Channel ret: %d", ret);

    const struct device *custom =
    DEVICE_DT_GET(DT_NODELABEL(our_custom0));

    if (!device_is_ready(custom)) {
    LOG_ERR("Custom API device is not ready");
    return;
    }

    int count = our_custom_increment_count(custom);
    printk("Custom API count: %d\n", count);

    count = our_custom_increment_count(custom);
    printk("Custom API count: %d\n", count);

    count = our_custom_increment_count(custom);
    printk("Custom API count: %d\n", count);
}
}
int main(void)
{
    test();

    printk("Application main started\n");
    printk("LED device ready: %d\n", gpio_is_ready_dt(&led));

    int ret = gpio_pin_configure_dt(&led, GPIO_OUTPUT_ACTIVE);
    printk("LED configure result: %d\n", ret);

    if (ret < 0) {
        return 0;
    }

    while (1) {
        ret = gpio_pin_toggle_dt(&led);
        //printk("LED toggle result: %d\n", ret);
        k_msleep(SLEEP_TIME_MS);
        //test();
    }

    return 0;
}
```
