## boards/arm/custom_board/board.yml
```yaml
board:
  name: custom_board
  full_name: custom_board
  vendor: iomico
  socs:
    - name: stm32f767xx
```

## boards/arm/custom_board_scratch/board.yml
```yaml
board:
   name: custom_board_scratch
   full_name: Custom Board From Scratch
   vendor: iomico
   socs:
    - name: stm32f767xx
```
